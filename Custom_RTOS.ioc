# file: Custom_RTOS.ioc
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Mcu.Family=STM32F4
Mcu.Name=STM32F429ZITx
Mcu.Package=LQFP144
NVIC.PriorityGroup=NVIC_PRIORITYGROUP_0
PA13.Mode=Serial_Wire
PA13.Signal=SYS_JTMS-SWDIO
PA14.Mode=Serial_Wire
PA14.Signal=SYS_JTCK-SWCLK
PH0/OSC_IN.Mode=HSE-External-Oscillator
PH0/OSC_IN.Signal=RCC_OSC_IN
PH1/OSC_OUT.Mode=HSE-External-Oscillator
PH1/OSC_OUT.Signal=RCC_OSC_OUT
ProjectManager.HeapSize=0x200
ProjectManager.StackSize=0x400
ProjectManager.TargetToolchain=STM32CubeIDE
RCC.48MHZClocksFreq_Value=51428571.428571425
RCC.AHBFreq_Value=180000000
RCC.APB1CLKDivider=RCC_HCLK_DIV4
RCC.APB1Freq_Value=45000000
RCC.APB1TimFreq_Value=90000000
RCC.APB2CLKDivider=RCC_HCLK_DIV2
RCC.APB2Freq_Value=90000000
RCC.APB2TimFreq_Value=180000000
RCC.CortexFreq_Value=180000000
RCC.HCLKFreq_Value=180000000
RCC.HSE_VALUE=8000000
RCC.HSI_VALUE=16000000
RCC.LSE_VALUE=32768
RCC.PLLM=4
RCC.PLLN=180
RCC.PLLQ=7
RCC.PLLSourceVirtual=RCC_PLLSOURCE_HSE
RCC.SYSCLKFreq_VALUE=180000000
RCC.SYSCLKSource=RCC_SYSCLKSOURCE_PLLCLK
RCC.VCOOutputFreq_Value=360000000
board=STM32F429I-DISC1

// file: Core/Src/main.c
/* USER CODE BEGIN Header */
/**
 ******************************************************************************
 * @file           : main.c
 * @brief          : Main program body
 ******************************************************************************
 * @attention
 *
 * <h2><center>&copy; Copyright (c) 2021 STMicroelectronics.
 * All rights reserved.</center></h2>
 *
 * This software component is licensed by ST under BSD 3-Clause license,
 * the "License"; You may not use this file except in compliance with the
 * License. You may obtain a copy of the License at:
 *                        opensource.org/licenses/BSD-3-Clause
 *
 ******************************************************************************
 */
/* USER CODE END Header */

#include "main.h"
#include "gpio.h"
#include "can.h"

/* USER CODE BEGIN PV */
static RTOS_thread_t thread1;
static RTOS_stack_t thread1stack;
static RTOS_thread_t thread2;
static RTOS_stack_t thread2stack;
static RTOS_thread_t thread3;
static RTOS_stack_t thread3stack;
static RTOS_thread_t thread4;
static RTOS_stack_t thread4stack;

static RTOS_mutex_t mutex1;
static RTOS_semaphore_t semaphore1;
static RTOS_mailbox_t mailbox1;
static uint32_t mailbox1buffer[3];
/* USER CODE END PV */

void SystemClock_Config(void);
/* USER CODE BEGIN PFP */

/**
 * @brief   thread1function
 * @note
 * @param   none
 * @retval  none
 */
void thread1function(void) {
	uint32_t msg = 0x11223344;

	while (1) {
		RTOS_SVC_semaphoreTake(&semaphore1, 1);
		 RTOS_SVC_semaphoreGive(&semaphore1);

		if(RTOS_SUCCESS == RTOS_SVC_mutexLock(&mutex1, 10))
		    {
		      RTOS_SVC_threadDelay(15);
		      RTOS_SVC_mutexRelease(&mutex1);
		    }
		    else
		    {
		    }
	    RTOS_SVC_threadDelay(1);
		 CAN1_Transmit_Red1();
	    RTOS_SVC_threadDelay(10);

		 CAN1_Transmit_Red2();
	    RTOS_SVC_threadDelay(10);

		 CAN1_Transmit_Green1();
	    RTOS_SVC_threadDelay(10);

		 CAN1_Transmit_Green2();
	    RTOS_SVC_threadDelay(10);
	}
}

/**
 * @brief   thread2function
 * @note
 * @param   none
 * @retval  none
 */
void thread2function(void) {

	uint32_t msg = 0x55667788;

	while (1) {
		RTOS_SVC_semaphoreTake(&semaphore1, 1);
		 RTOS_SVC_semaphoreGive(&semaphore1);

		if(RTOS_SUCCESS == RTOS_SVC_mutexLock(&mutex1, 10))
		    {
		      RTOS_SVC_threadDelay(15);
		      RTOS_SVC_mutexRelease(&mutex1);
		    }
		    else
		    {
		    }

		    RTOS_SVC_threadDelay(1);
	    CAN1_Receive();
	    RTOS_SVC_threadDelay(1);
	}
}

/**
 * @brief   thread2function
 * @note
 * @param   none
 * @retval  none
 */
void thread3function(void) {
	uint32_t msg = 0x99101011;

	while (1) {
	    if(RTOS_SUCCESS == RTOS_SVC_mutexLock(&mutex1, 10))
	    {
	      ITM_Printf("Thread 3: Mutex lock succeeded \n");
	      RTOS_SVC_threadDelay(15);
	      RTOS_SVC_mutexRelease(&mutex1);
	    }
	    else
	    {

	    }

	    RTOS_SVC_threadDelay(1);
	}
}

/**
 * @brief   thread2function
 * @note
 * @param   none
 * @retval  none
 */
void thread4function(void) {

	while (1) {

	}
}

/* USER CODE END PFP */

int main(void) {

	/* MCU Configuration--------------------------------------------------------*/

	/* Reset of all peripherals, Initializes the Flash interface and the Systick. */

	/* Configure the system clock */

	/* USER CODE BEGIN SysInit */

	CAN1_Init();

	RTOS_init();

	RTOS_SVC_threadCreate(&thread1, &thread1stack, 1, thread1function);
	RTOS_SVC_threadCreate(&thread2, &thread2stack, 1, thread2function);
	RTOS_SVC_threadCreate(&thread3, &thread3stack, 1, thread3function);
	RTOS_SVC_threadCreate(&thread4, &thread4stack, 1, thread4function);

	RTOS_SVC_mutexCreate(&mutex1, 1);
	RTOS_SVC_semaphoreCreate(&semaphore1, 1);
	RTOS_SVC_mailboxCreate(&mailbox1, mailbox1buffer, 2, 4);

	RTOS_SVC_schedulerStart();

	/* USER CODE END SysInit */

	/* Initialize all configured peripherals */

	/* Infinite loop */
	while (1) {

	}
}

void SystemClock_Config(void) {
	RCC_OscInitTypeDef RCC_OscInitStruct = { 0 };
	RCC_ClkInitTypeDef RCC_ClkInitStruct = { 0 };

	/** Configure the main internal regulator output voltage
	 */
	__HAL_RCC_PWR_CLK_ENABLE();
	__HAL_PWR_VOLTAGESCALING_CONFIG(PWR_REGULATOR_VOLTAGE_SCALE1);
	/** Initializes the RCC Oscillators according to the specified parameters
	 * in the RCC_OscInitTypeDef structure.
	 */
	RCC_OscInitStruct.OscillatorType = RCC_OSCILLATORTYPE_HSE;
	RCC_OscInitStruct.HSEState = RCC_HSE_ON;
	RCC_OscInitStruct.PLL.PLLState = RCC_PLL_ON;
	RCC_OscInitStruct.PLL.PLLSource = RCC_PLLSOURCE_HSE;
	RCC_OscInitStruct.PLL.PLLM = 4;
	RCC_OscInitStruct.PLL.PLLN = 180;
	RCC_OscInitStruct.PLL.PLLP = RCC_PLLP_DIV2;
	RCC_OscInitStruct.PLL.PLLQ = 7;
	if (HAL_RCC_OscConfig(&RCC_OscInitStruct) != HAL_OK) {
		Error_Handler();
	}
	/** Activate the Over-Drive mode
	 */
	if (HAL_PWREx_EnableOverDrive() != HAL_OK) {
		Error_Handler();
	}
	/** Initializes the CPU, AHB and APB buses clocks
	 */
	RCC_ClkInitStruct.ClockType = RCC_CLOCKTYPE_HCLK | RCC_CLOCKTYPE_SYSCLK
			| RCC_CLOCKTYPE_PCLK1 | RCC_CLOCKTYPE_PCLK2;
	RCC_ClkInitStruct.SYSCLKSource = RCC_SYSCLKSOURCE_PLLCLK;
	RCC_ClkInitStruct.AHBCLKDivider = RCC_SYSCLK_DIV1;
	RCC_ClkInitStruct.APB1CLKDivider = RCC_HCLK_DIV4;
	RCC_ClkInitStruct.APB2CLKDivider = RCC_HCLK_DIV2;

	if (HAL_RCC_ClockConfig(&RCC_ClkInitStruct, FLASH_LATENCY_5) != HAL_OK) {
		Error_Handler();
	}
}

/* USER CODE BEGIN 4 */

/************************ (C) COPYRIGHT STMicroelectronics *****END OF FILE****/
